/*
 * TOTEM (38 key, Seeed XIAO BLE) — thin shim.
 *
 * The physical arrangement is the default ZMK_BASE_LAYER in base.keymap
 * (5 alpha columns + 6-key bottom row + 3 thumbs per half), so nothing
 * needs to be overridden here.
 *
 * All layout content lives in config/base.keymap.
 */

#include "zmk-helpers/key-labels/totem.h"
#include "base.keymap"
